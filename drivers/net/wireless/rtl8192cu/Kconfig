## drivers/net/wireless/rtl8192cu/Kconfig
```kconfig
config RTL8192CU
	tristate "Realtek 8192C USB WiFi"
	depends on USB
        select CONFIG_RTL8192C
        select CONFIG_USB_HCI
	---help---
	  Help message of RTL8192CU
```
